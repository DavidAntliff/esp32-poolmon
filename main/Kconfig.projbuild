## main/Kconfig.projbuild
```kconfig
menu "esp32-poolmon Configuration"

config WIFI_SSID
    string "WiFi SSID"
    default "myssid"
    help
        SSID (network name) for the example to connect to.

config WIFI_PASSWORD
    string "WiFi Password"
    default "mypassword"
    help
        WiFi password (WPA or WPA2) for the example to use.

config MQTT_BROKER_IP_ADDRESS
    string "MQTT Broker IP Address"
    help
        IP address or name of MQTT broker.

config MQTT_BROKER_TCP_PORT
    int "MQTT Broker TCP Port"
    range 0 65535
    default 1883
    help
        TCP Port to use to connect to MQTT broker.

config ONBOARD_LED_GPIO
    int "Onboard LED GPIO number"
    range 0 34
    default 2
    help
        GPIO number (IOxx) connected to onboard LED.

config ONE_WIRE_GPIO
    int "OneWire GPIO number"
    range 0 34
    default 4
    help
        GPIO number (IOxx) to access One Wire Bus.

        Some GPIOs are used for other purposes (flash connections, etc.) and cannot be used.

        GPIOs 35-39 are input-only so cannot be used to drive the One Wire Bus.

config DISPLAY_BUTTON_GPIO
    int "Display Button GPIO number"
    range 0 34
    default 22
    help
        GPIO number (IOxx) to read the Display Button state.

        Some GPIOs are used for other purposes (flash connections, etc.) and cannot be used.

config I2C_MASTER_SCL_GPIO
    int "I2C Master SCL GPIO number"
    range 0 34
    default 19
    help
        GPIO number (IOxx) for I2C SCL.

        Some GPIOs are used for other purposes (flash connections, etc.) and cannot be used.

        GPIOs 35-39 are input-only so cannot be used to drive the I2C bus.

config I2C_MASTER_SDA_GPIO
    int "I2C Master SDA GPIO number"
    range 0 34
    default 18
    help
        GPIO number (IOxx) for I2C SDA.

        Some GPIOs are used for other purposes (flash connections, etc.) and cannot be used.

        GPIOs 35-39 are input-only so cannot be used to drive the I2C bus.

config AVR_I2C_ADDRESS
    hex "I2C Address for AVR device"
    default 0x44
    help
        I2C address for AVR ATtiny84A device.

config LCD1602_I2C_ADDRESS
    hex "I2C Address for LCD1602 device"
    default 0x27
    help
        I2C address for HD44780-compatible LCD1602 device.

config LIGHT_SENSOR_I2C_ADDRESS
    hex "I2C Address for Light Sensor device"
    default 0x39
    help
        I2C address for TSL2561 ambient light sensor device.

        If ADDR Sel pin is tied to GND, the address is 0x29.
        If ADDR Sel pin is floating, the address is 0x39.
        If ADDR Sel pin is tied to VCC, the address is 0x49.

config FLOW_METER_PULSE_GPIO
    int "Flow Meter Counter GPIO number"
    range 0 34
    default 5
    help
        GPIO number (IOxx) for Flow Meter pulse signal, counted by PCNT.

        Some GPIOs are used for other purposes (flash connections, etc.) and cannot be used.

config FLOW_METER_RMT_GPIO
    int "Flow Meter RMT GPIO number"
    range 0 34
    default 23
    help
        GPIO number (IOxx) for Flow Meter sampling window signal, generated by RMT.

        Some GPIOs are used for other purposes (flash connections, etc.) and cannot be used.

        GPIOs 35-39 are input-only so cannot be used to drive the sampling window.

config AVR_RESET_GPIO
    int "AVR Reset GPIO number"
    range 0 34
    default 21
    help
        GPIO number (IOxx) for resetting the AVR by pulling low for a period of time.

        Some GPIOs are used for other purposes (flash connections, etc.) and cannot be used.

        GPIOs 35-39 are input-only so cannot be used to reset the AVR.
        
endmenu
```

## sdkconfig.defaults
```kconfig
#
# Partition Table
#
CONFIG_PARTITION_TABLE_TWO_OTA=y
CONFIG_PARTITION_TABLE_FILENAME="partitions_two_ota.csv"
CONFIG_PARTITION_TABLE_OFFSET=0x8000
CONFIG_PARTITION_TABLE_MD5=y

#
# Log output
#
CONFIG_LOG_DEFAULT_LEVEL=4
```
